## Kconfig
```kconfig
menu "demo-ecu"


config APP_MICROPYTHON_TASK_STACK_SIZE
       int "MP task stack size"
       default 6656

config APP_MICROPYTHON_TASK_PRIORITY
       int "MP Task prio"
       default 2


menu "Sensors task configuration"
config APP_SENSORS_TASK_STACK_SIZE
       int "Stack size (bytes)"
       default 800

config APP_SENSORS_TASK_PRIORITY
       int "Task priority"
       default 3

config APP_GPS_UART_PORT
       int "GPS UART port"

config APP_GPS_UART_BAUD
       int "GPS baud rate"
       default 38400

config APP_SENSORS_SLOW_SAMPLE_PERIOD_MS
       int "Sampling period for slow sensors"
endmenu


menu "RC receiver communication task configuration"
config APP_RC_RECEIVER_TASK_STACK_SIZE
       int "Stack size (bytes)"
       default 800

config APP_RC_RECEIVER_TASK_PRIORITY
       int "Task priority"
       default 3

config APP_RC_RECEIVER_UART_PORT
       int "UART port connected to RC receiver"


endmenu


menu "RPM task configuration"
config APP_RPM_TASK_STACK_SIZE
       int "Stack size (bytes)"
       default 800

config APP_RPM_TASK_PRIORITY
       int "Task priority"
       default 3

config APP_RPM_INPUT_CAPTURE
       int "Input capture channel"

config APP_RPM_TIMER
       int "Input capture base timer"

config APP_RPM_SAMPLING_PERIOD_MS
       int "RPM sampling period (ms)"
       default 25

config APP_RPM_MAX_PERIOD_LIMIT_MS
       int "Maximum supported period of the measured signal (ms)"
       default 1000

endmenu

endmenu
```

## Kconfig.generated
```kconfig
mainmenu "Toplevel Project Configuration"


config FREERTOS_DIR
       string
       default "../../freertos"

config FREERTOS_DRIVERS_DIR
       string
       default "../../freertos-drivers"

config LIB_RTOS_DIR
       string
       default "../../lib-rtos"

config LIB_ALGORITHMS_DIR
       string
       default "../../lib-algorithms"

config LIB_DAQ_DIR
       string
       default "../../lib-daq"

config LIB_IC_DIR
       string
       default "../../lib-ic"

config LIB_NMEA_DIR
       string
       default "../../lib-nmea"

config LIB_RC_DIR
       string
       default "../../lib-rc"

config STELLARISWARE_DIR
       string
       default "../../stellarisware"

config STELLARISWARE_DRIVERS_DIR
       string
       default "../../stellarisware-drivers"

config STM32_HAL_DIR
       string
       default "../../stm32-hal"

config STM32_CMSIS_DIR
       string
       default "../../stm32-cmsis"

config LIBC_BACKEND_DIR
       string
       default "../../libc-backend"

config MICROPYTHON_DIR
       string
       default "../../micropython"

config MICROPYTHON_FREERTOS_HAL_DIR
       string
       default "../../micropython-freertos-hal"

config BSP_DIR
       string
       default "../../bsp"

config LIB_COBJS_DIR
       string
       default "../../lib-cobjs"


source "$FREERTOS_DIR/Kconfig"
source "$FREERTOS_DRIVERS_DIR/Kconfig"
source "$LIB_RTOS_DIR/Kconfig"
source "$LIB_ALGORITHMS_DIR/Kconfig"
source "$LIB_DAQ_DIR/Kconfig"
source "$LIB_IC_DIR/Kconfig"
source "$LIB_RC_DIR/Kconfig"
source "$STM32_HAL_DIR/Kconfig"
source "$MICROPYTHON_DIR/Kconfig"
source "$MICROPYTHON_FREERTOS_HAL_DIR/Kconfig"
source "$BSP_DIR/Kconfig"
source "Kconfig"
```
